## sdkconfig.defaults
```kconfig
CONFIG_IDF_TARGET="esp32s3"
CONFIG_ESPTOOLPY_FLASHSIZE_8MB=y
CONFIG_COMPILER_OPTIMIZATION_PERF=y
CONFIG_FREERTOS_HZ=1000
CONFIG_TUSB_VID=0xDEAD
CONFIG_TUSB_PID=0xBEEF
CONFIG_TUSB_MANUFACTURER="Espressif"
CONFIG_TUSB_PRODUCT="ESP32-S3 MLX90642 Thermal Camera"
#CONFIG_FORMAT_MJPEG_CAM1=y
CONFIG_FORMAT_UNCOMPR_CAM1=y
CONFIG_FRAMESIZE_QVGA=y
CONFIG_UVC_CAM1_FRAMESIZE_WIDTH=32
CONFIG_UVC_CAM1_FRAMESIZE_HEIGT=24
CONFIG_UVC_CAM1_MULTI_FRAMESIZE=n
CONFIG_UVC_MULTI_FRAME_FPS_1=30
```
